## boards/lego/spike_prime_f4/Kconfig
```kconfig
# SPDX-License-Identifier: Apache-2.0
config BOARD_SPIKE_PRIME_F4
	select BOARD_EARLY_INIT_HOOK
	select BT_HCI_SETUP if BT
```

## boards/lego/spike_prime_f4/Kconfig.spike_prime_f4
```kconfig
# SPDX-License-Identifier: Apache-2.0
config BOARD_SPIKE_PRIME_F4
	select SOC_STM32F413XX
```

## boards/lego/spike_prime_f4/board.yml
```yaml
# SPDX-License-Identifier: Apache-2.0
board:
  name: spike_prime_f4
  full_name: LEGO SPIKE Prime (STM32F413VG)
  vendor: lego
  socs:
    - name: stm32f413xx
```

## boards/lego/technic_hub/Kconfig
```kconfig
# SPDX-License-Identifier: Apache-2.0
config BOARD_TECHNIC_HUB
	select BOARD_EARLY_INIT_HOOK
	select INIT_ARCH_HW_AT_BOOT
```

## boards/lego/technic_hub/Kconfig.technic_hub
```kconfig
# SPDX-License-Identifier: Apache-2.0
config BOARD_TECHNIC_HUB
	select SOC_STM32L431XX
```

## boards/lego/technic_hub/board.yml
```yaml
# SPDX-License-Identifier: Apache-2.0
board:
  name: technic_hub
  full_name: LEGO Technic Hub (STM32L431RC)
  vendor: lego
  socs:
    - name: stm32l431xx
```

## dts/bindings/misc/lego,powered-up-ports.yaml
```yaml
# SPDX-License-Identifier: Apache-2.0
description: Powered Up electrical identification and shared logic supply
compatible: "lego,powered-up-ports"
include: base.yaml

properties:
  sync-timer:
    type: phandle
    description: F4 shared H-bridge PWM reset/update timer, owned by the port output driver
  vcc-gpios:
    type: phandle-array
    required: true
    description: Shared device logic supply enable, not motor power
  "#address-cells":
    const: 1
  "#size-cells":
    const: 0

child-binding:
  description: One external port; reg is its zero-based index (A is 0)
  include: pinctrl-device.yaml
  properties:
    pwms:
      type: phandle-array
      description: H-bridge PWM outputs in P1, P2 order, inverted on Prime F4
    uart:
      type: phandle
      description: UART controller used after electrical identification
    p1-gpios:
      type: phandle-array
      description: H-bridge P1 input; both low is coast, P1 high supplies positive P1
    p2-gpios:
      type: phandle-array
      description: H-bridge P2 input; paired with p1-gpios
    reg:
      type: int
      required: true
    p5-gpios:
      type: phandle-array
      required: true
    p6-gpios:
      type: phandle-array
      required: true
    tx-gpios:
      type: phandle-array
      required: true
    rx-gpios:
      type: phandle-array
      required: true
    buffer-gpios:
      type: phandle-array
      required: true
      description: Active-low UART buffer enable
```

## dts/bindings/misc/lego,prime-f4-speaker.yaml
```yaml
# SPDX-License-Identifier: Apache-2.0
description: Prime F4 amplified speaker using DAC1 channel 1 and TIM6 TRGO
compatible: "lego,prime-f4-speaker"
include: [base.yaml, pinctrl-device.yaml, reset-device.yaml]
properties:
  reg:
    required: true
  reg-names:
    required: true
    description: DAC and TIM6 register regions, named dac and timer.
  clocks:
    required: true
  clock-names:
    required: true
    description: DAC gate, TIM6 gate and timer source, named dac, timer and sample.
  resets:
    required: true
  interrupts:
    required: true
  enable-gpios:
    type: phandle-array
    required: true
  dmas:
    required: true
  dma-names:
    required: true
```

## dts/bindings/power/lego,prime-charger.yaml
```yaml
# SPDX-License-Identifier: Apache-2.0
description: SPIKE Prime MP2639A charger wiring and Pybricks current presets
compatible: "lego,prime-charger"
properties:
  mode-controller:
    type: phandle
    required: true
    description: TLC5955 holding the reserved charger MODE channel.
  mode-channel:
    type: int
    required: true
  pwms:
    type: phandle-array
    required: true
    description: ISET PWM, active high, 96 kHz on F4.
  io-channels:
    type: phandle-array
    required: true
    description: Charger current observation (IBUSBCH).
  status-ladder:
    type: phandle
    required: true
  status-bit:
    type: int
    required: true
    description: Debounced active-low CHG input bit in the resistor ladder.
```

## dts/bindings/sensor/st,lsm6ds3tr-c.yaml
```yaml
# SPDX-License-Identifier: Apache-2.0
description: ST LSM6DS3TR-C hub accelerometer and gyroscope
compatible: "st,lsm6ds3tr-c"
include: i2c-device.yaml
properties:
  irq-gpios:
    type: phandle-array
    required: true
    description: Active-high INT1 data-ready signal
  axis-signs:
    type: array
    required: true
    description: Sensor-to-hub X/Y/Z signs, each 1 or -1
```

## tests/ports/dts/bindings/gpio/vnd,pup-test-gpio.yaml
```yaml
# SPDX-License-Identifier: Apache-2.0
description: Synthetic Powered Up wiring for electrical identification checks
compatible: "vnd,pup-test-gpio"
include: [gpio-controller.yaml, base.yaml]
properties:
  port-index:
    type: int
    required: true
  "#gpio-cells":
    const: 2
gpio-cells: [pin, flags]
```

## tests/ports/dts/bindings/pwm/vnd,pup-test-pwm.yaml
```yaml
# SPDX-License-Identifier: Apache-2.0
description: Fake PWM with flags for paired motor outputs
compatible: "vnd,pup-test-pwm"
include: [pwm-controller.yaml, base.yaml]
properties:
  "#pwm-cells":
    const: 3
  frequency:
    type: int
    required: true
pwm-cells:
  - channel
  - period
  - flags
```

## tests/poweroff/testcase.yaml
```yaml
# SPDX-License-Identifier: Apache-2.0
tests:
  brickphyr.poweroff.usb_wake:
    platform_allow: native_sim/native/64
    integration_platforms: [native_sim/native/64]
    extra_args: USB_WAKE=ON
    tags: [power, usb]
    timeout: 5
  brickphyr.poweroff:
    platform_allow: [native_sim/native/64]
    integration_platforms: [native_sim/native/64]
    tags: [power, input]
    timeout: 5
```

## tests/python/testcase.yaml
```yaml
tests:
  brickphyr.python.runtime:
    platform_allow: native_sim/native/64
    integration_platforms: [native_sim/native/64]
    tags: [python]
  brickphyr.python.arm:
    platform_allow: mps2/an386
    integration_platforms: [mps2/an386]
    extra_args: EXTRA_CONF_FILE=arm.conf;../arm.conf
    tags: [python, userspace]
```

## tests/radio/testcase.yaml
```yaml
# SPDX-License-Identifier: Apache-2.0
tests:
  brickphyr.radio:
    platform_allow: [native_sim/native/64]
    integration_platforms: [native_sim/native/64]
    tags: [bluetooth, shell]
    timeout: 5
```

## tests/usb_power/Kconfig
```kconfig
# SPDX-License-Identifier: Apache-2.0
mainmenu "USB power coordinator fixture"
source "Kconfig.zephyr"

config BRICKPHYR_USB_BC12
	bool
	default y

config BRICKPHYR_CHARGER
	bool
	default y
```

## tests/usb_power/dts/bindings/test/vnd,usb-power-test.yaml
```yaml
# SPDX-License-Identifier: Apache-2.0
description: Synthetic USB controller and BC1.2 detector for power coordinator tests
compatible: "vnd,usb-power-test"
include: base.yaml
```
