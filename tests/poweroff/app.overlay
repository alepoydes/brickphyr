// SPDX-License-Identifier: Apache-2.0
/ {
	zephyr,user {
		vbus-gpios = <&gpio0 0 GPIO_ACTIVE_HIGH>;
	};
};
adc1: &adc0 {
	ref-internal-mv = <3300>;
	nchannels = <15>;
};
#include "../../boards/lego/spike_prime_f4/buttons.dtsi"
#include "../watchdog/app.overlay"
