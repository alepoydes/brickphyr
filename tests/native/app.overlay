/* SPDX-License-Identifier: Apache-2.0 */
/ {
	hub_speaker: speaker {
		compatible = "vnd,sound-output";
		status = "okay";
	};
};
#include "lights.dtsi"
#include "battery.dtsi"
#include "../ports/ports.dtsi"
#include "../ports/motor-pwm.dtsi"
