/* SPDX-License-Identifier: Apache-2.0 */
/ {
	test_uart: uart-emul {
		compatible = "zephyr,uart-emul";
		status = "okay";
		current-speed = <115200>;
		rx-fifo-size = <256>;
		tx-fifo-size = <256>;
	};
};
