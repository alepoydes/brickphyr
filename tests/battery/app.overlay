// SPDX-License-Identifier: Apache-2.0
adc1: &adc0 {
	ref-internal-mv = <3300>;
	nchannels = <15>;
};
#include "../../boards/lego/spike_prime_f4/buttons.dtsi"
#include "../../boards/lego/spike_prime_f4/battery.dtsi"
