## tests/usb_power/testcase.yaml
```yaml
# SPDX-License-Identifier: Apache-2.0
tests:
  brickphyr.usb_power:
    platform_allow: [native_sim/native/64]
    integration_platforms: [native_sim/native/64]
    tags: [usb, power]
    timeout: 5
```

## tests/watchdog/dts/bindings/watchdog/vnd,watchdog-test.yaml
```yaml
# SPDX-License-Identifier: Apache-2.0
description: Watchdog boundary for native system-supervision tests
compatible: "vnd,watchdog-test"
include: base.yaml
```

## tests/watchdog/testcase.yaml
```yaml
# SPDX-License-Identifier: Apache-2.0
common:
  platform_allow: [native_sim/native/64]
  integration_platforms: [native_sim/native/64]
  tags: [watchdog]
  harness: console
  harness_config:
    type: one_line
    regex: ["Watchdog recovery verified"]
  timeout: 5
tests:
  brickphyr.watchdog.hub: {}
  brickphyr.watchdog.workqueue:
    extra_args: STALL_WORKQUEUE=ON
```
